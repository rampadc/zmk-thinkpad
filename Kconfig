## Kconfig
```kconfig
# SPDX-License-Identifier: MIT

menuconfig THINKPAD_T430_STATUS
    bool "ThinkPad T430 indicator LEDs"
    default y if SHIELD_THINKPAD_T430 || SHIELD_THINKPAD_T430_REVA
    depends on ZMK_BLE && ZMK_USB
    help
      Drives the T430 power-button LED steadily while USB or BLE is connected, drives
      three BLE-profile indicators, and mirrors the dedicated
      speaker/microphone mute buttons to their LEDs.

config THINKPAD_T430_REVA_BACKLIGHT
    bool "ThinkPad T430 Revision A sequenced backlight"
    default y if SHIELD_THINKPAD_T430_REVA
    depends on PWM && GPIO
    help
      Drives the Revision A backlight PWM and sequences its active-high 5 V
      rail enable so PWM is never applied before the rail has stabilized.

config THINKPAD_T430_REVA_USB_BOOT_TRIGGER
    bool "ThinkPad T430 Revision A 1200-baud UF2 trigger"
    default y if SHIELD_THINKPAD_T430_REVA
    depends on SERIAL && UART_LINE_CTRL
    help
      Reboots into the UF2 bootloader when the USB CDC ACM control port is
      opened at 1200 baud. This permits button-free firmware updates.

menuconfig THINKPAD_MATRIX_DISCOVERY
    bool "ThinkPad keyboard matrix discovery logging"
    default n
    depends on LOG
    help
      Guides the user through the selected ThinkPad layout and records each
      matrix or direct-input position. Enable only for matrix bring-up.

config THINKPAD_MATRIX_DISCOVERY_T430
    bool
    default y if THINKPAD_MATRIX_DISCOVERY && (SHIELD_THINKPAD_T430 || SHIELD_THINKPAD_T430_REVA)

config THINKPAD_MATRIX_DISCOVERY_T470
    bool
    default y if THINKPAD_MATRIX_DISCOVERY && SHIELD_THINKPAD_T470

menuconfig THINKPAD_T470_STATUS
    bool "ThinkPad T470 BLE profile LEDs"
    default y if SHIELD_THINKPAD_T470
    depends on ZMK_BLE && ZMK_USB
    help
      Uses three nRF52840 DK LEDs to show selected BLE profile, pairing,
      connection, and reconnection state.
```

## boards/arm/holyiot_18010_nrf52840/Kconfig
```kconfig
# SPDX-License-Identifier: MIT

if BOARD_HOLYIOT_18010_NRF52840

config BOARD_ENABLE_DCDC
	bool "DCDC mode"
	select SOC_DCDC_NRF52X

config BOARD_ENABLE_DCDC_HV
	bool "High-voltage DCDC converter"
	select SOC_DCDC_NRF52X_HV

endif
```

## boards/arm/holyiot_18010_nrf52840/Kconfig.board
```kconfig
# SPDX-License-Identifier: MIT

config BOARD_HOLYIOT_18010_NRF52840
	bool "Holyiot 18010 nRF52840"
	depends on SOC_NRF52840_QIAA
```

## boards/arm/holyiot_18010_nrf52840/Kconfig.defconfig
```kconfig
# SPDX-License-Identifier: MIT

if BOARD_HOLYIOT_18010_NRF52840

config BOARD
	default "holyiot_18010_nrf52840"

config BT_CTLR
	default BT

config BOARD_ENABLE_DCDC
	default y

config BOARD_ENABLE_DCDC_HV
	default y

endif
```

## boards/arm/holyiot_18010_nrf52840/holyiot_18010_nrf52840_defconfig
```kconfig
# SPDX-License-Identifier: MIT

CONFIG_SOC_SERIES_NRF52X=y
CONFIG_SOC_NRF52840_QIAA=y
CONFIG_BOARD_HOLYIOT_18010_NRF52840=y

CONFIG_ARM_MPU=y
CONFIG_HW_STACK_PROTECTION=y
CONFIG_GPIO=y
CONFIG_SERIAL=y
CONFIG_CONSOLE=y
CONFIG_USE_SEGGER_RTT=y
CONFIG_RTT_CONSOLE=y
CONFIG_UART_CONSOLE=n

CONFIG_CLOCK_CONTROL_NRF_K32SRC_XTAL=y
CONFIG_CLOCK_CONTROL_NRF_K32SRC_50PPM=y
CONFIG_GPIO_AS_PINRESET=y
CONFIG_BUILD_OUTPUT_UF2=y
CONFIG_BUILD_OUTPUT_UF2_FAMILY_ID="0xADA52840"
CONFIG_USE_DT_CODE_PARTITION=y
```

## boards/shields/thinkpad_t430/Kconfig.defconfig
```kconfig
# SPDX-License-Identifier: MIT

if SHIELD_THINKPAD_T430

config ZMK_KEYBOARD_NAME
    default "ThinkPad T430"

endif
```

## boards/shields/thinkpad_t430/Kconfig.shield
```kconfig
# SPDX-License-Identifier: MIT

config SHIELD_THINKPAD_T430
    def_bool $(shields_list_contains,thinkpad_t430)
```

## boards/shields/thinkpad_t430_reva/Kconfig.defconfig
```kconfig
# SPDX-License-Identifier: MIT

if SHIELD_THINKPAD_T430_REVA

config ZMK_KEYBOARD_NAME
    string
    default "T430 RevA"

endif
```

## boards/shields/thinkpad_t470/Kconfig.defconfig
```kconfig
# SPDX-License-Identifier: MIT

if SHIELD_THINKPAD_T470

config ZMK_KEYBOARD_NAME
    string
    default "ThinkPad T470"

endif
```

## boards/shields/thinkpad_t470/Kconfig.shield
```kconfig
# SPDX-License-Identifier: MIT

config SHIELD_THINKPAD_T470
    def_bool $(shields_list_contains,thinkpad_t470)
```

## boards/shields/thinkpad_t60_reva/Kconfig.defconfig
```kconfig
# SPDX-License-Identifier: MIT

if SHIELD_THINKPAD_T60_REVA

config ZMK_KEYBOARD_NAME
    string
    default "T60 RevA"

endif
```

## boards/shields/thinkpad_t60_reva/Kconfig.shield
```kconfig
# SPDX-License-Identifier: MIT

config SHIELD_THINKPAD_T60_REVA
    def_bool $(shields_list_contains,thinkpad_t60_reva)
```

## config/west.yml
```yaml
manifest:
  defaults:
    revision: v0.3
  remotes:
    - name: zmkfirmware
      url-base: https://github.com/zmkfirmware
    - name: rampadc
      url-base: https://github.com/rampadc
  projects:
    - name: zmk
      remote: zmkfirmware
      import: app/west.yml
    - name: kb_zmk_ps2_mouse_trackpoint_driver
      remote: rampadc
      revision: 7ab7846a95b233c3ada0e0605b972f36353e7bc4
  self:
    path: config
```

## dts/bindings/behaviors/zmk,behavior-thinkpad-profile-command.yaml
```yaml
# SPDX-License-Identifier: MIT

description: ThinkPad USB and BLE profile command behavior
compatible: "zmk,behavior-thinkpad-profile-command"
include: two_param.yaml
```

## dts/bindings/led/thinkpad,reva-pwm-backlight.yaml
```yaml
description: ThinkPad Revision A PWM backlight with a sequenced supply enable

compatible: "thinkpad,reva-pwm-backlight"

include: base.yaml

properties:
  enable-gpios:
    type: phandle-array
    required: true

  startup-delay-ms:
    type: int
    default: 35

child-binding:
  description: PWM-controlled keyboard backlight channel
  properties:
    pwms:
      type: phandle-array
      required: true
```
